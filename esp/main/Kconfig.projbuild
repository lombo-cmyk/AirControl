## esp/main/Kconfig.projbuild
```kconfig
menu "Project configuration"

    config ESP_WIFI_SSID
        string "WiFi SSID"
        default "ssid_name"
        help
            SSID (network name) to connect to.

    config ESP_WIFI_PASSWORD
        string "WiFi Password"
        default "dummy_pass"
        help
            WiFi password (WPA or WPA2) to use.

    config ESP_MAXIMUM_RETRY
        int "Maximum retry"
        default 5
        help
            Set the Maximum retry to avoid station reconnecting to the AP unlimited when the AP is unreachable.

    menu "Stubs"
        config INCLUDE_STUBS
            bool "Include stubs instead of actual devices"
            default 0
            help
                Set the variable to True to stub peripheral devices

        config STUB_LCD
            bool "Stub LCD screen"
            default 0
            help
                Set the variable to True to stub peripheral device

        config STUB_TEMPERATURE
            bool "Stub Temperature sensor"
            default 0
            help
                Set the variable to True to stub peripheral device
    endmenu
endmenu
```
